#include "PDQ_ST7735_config.h"

#include <PDQ_FastPin.h>
#include <PDQ_GFX.h>
#include <PDQ_ST7735.h>
#include <gfxfont.h>

#include <ArduinoSTL.h>
#include <system_configuration.h>
#include <time.h>
#include <unwind-cxx.h>
#include <vector>

static const PROGMEM uint16_t background[] = {
    0x20, 0x841, 0x861, 0x1082, 0x10a2, 0x18c3, 0x18e3, 0x2104, 0x2124, 0x2945, 0x2965, 0x3186,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 0xf7de, 0xffff};
static const PROGMEM uint16_t file[] = {
    0x528a, 0xff90, 0xff90, 0xf794, 0x5a66, 0x5a69, 0x4a6a, 0x5269, 0x5249, 0x528a, 0x5a6a, 0x5a66,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 0x4a69, 0x4a69};
static const PROGMEM uint16_t text_file[] = {
    0x7411, 0x7411, 0x7411, 0x7411, 0x7411, 0xad75, 0x7411, 0xffff, 0xffff, 0xffff, 0xffff, 0x7411,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 0x7411, 0x7411};
static const PROGMEM uint16_t unknown_file[] = {
    0x7411, 0x7411, 0x7411, 0x7411, 0x7411, 0xad75, 0x7411, 0xffff, 0xffff, 0xffff, 0xffff, 0x7411,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 0x7411, 0x7411};
static const PROGMEM uint16_t clock_icon[] = {
    0xa815, 0xa815, 0x0, 0x0, 0x0, 0x0, 0xa815, 0xa815, 0xa815, 0x0, 0xffff, 0xffff,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 0xa815, 0xa815};
time_t unixtimestamp = 0;
#pragma GCC optimize("-O3")

//Input
#define RIGHT 7
bool lastRIGHTstate = false;
bool currentRIGHTstate = false;

#define LEFT 6
bool lastLEFTstate = false;
bool currentLEFTstate = false;

#define A 5
bool lastAstate = false;
bool currentAstate = false;

#define B 4
bool lastBstate = false;
bool currentBstate = false;

#define START 3
bool lastSTARTstate = false;
bool currentSTARTstate = false;

PDQ_ST7735 tft;

int timezoneOffset = 2;  //TODO: Make this changable

struct Folder {
    String name;
    std::vector<String> contents;  //! G O D I S D E A D
    Folder() {
        name = "!!!!";
    }
    Folder(String x) {
        name = x;
    };
    String getFileName(int index) {
        return contents[index].substring(contents[index].indexOf("[") + 1, contents[index].indexOf("]"));
    }
    String getFileContents(int index) {
        return contents[index].substring(contents[index].indexOf("]") + 1);
    }
};
std::vector<Folder> folders{Folder("%SYS"), Folder("%DAT")};

void drawBMPCustom(uint16_t x, uint16_t y, uint16_t w, uint16_t sf, const uint16_t *bitmp, size_t len, uint16_t stp) {
    for (int i = 0; i < len / sizeof(pgm_read_word(bitmp)); i++) {
        tft.fillRect(x + (i % w) * sf, y + floor(i / w) * sf, sf, sf, pgm_read_word_near(bitmp + i));
        if (i > stp && stp > 0) {  //Break after stp pixels
            break;
        }
    }
}
void drawBMPCustomTransparency(uint16_t x, uint16_t y, uint16_t w, uint16_t sf, const uint16_t *bitmp, size_t len, uint16_t stp) {
    for (int i = 0; i < len / sizeof(pgm_read_word(bitmp)); i++) {
        if (pgm_read_word_near(bitmp + i) == 0xA815) {  //Skips over #B000B0
            continue;
        }
        tft.fillRect(x + (i % w) * sf, y + floor(i / w) * sf, sf, sf, pgm_read_word_near(bitmp + i));
        if (i > stp && stp > 0) {  //Break after stp pixels
            break;
        }
    }
}
void drawBackground(uint16_t stp) {
    drawBMPCustom(0, 2, 40, 4, background, sizeof(background), stp);  //Background
    for (int i = 0; i < folders.size(); i++) {
        drawBMPCustom(10 + (i % 4 * 18 * 2), 20 + 34 * floor(i / 4), 13, 2, file, sizeof(file), 0);  //Draw file icon
        tft.setCursor(11 + (i % 4 * 18 * 2), 40 + 32 * floor(i / 4));
        tft.print(folders[i].name);
    }
}
void drawTaskbar(int index) {
    tft.fillRect(0, 110, 160, 18, 0x1B7F);  //Task Bar
    tft.fillRect(0 + index * 19, 110, 19, 18, 0x8F5F);
    drawBMPCustomTransparency(2, 111, 8, 2, clock_icon, sizeof(clock_icon), 0);
}
void fpsCounter(double fps) {
    tft.fillRect(0, 0, 38, 10, 0);
    tft.setCursor(2, 2);
    tft.print(fps);
    //Serial.println(fps);
}
void drawFileSelection(int num) {
    tft.drawFastVLine(7 + num % 4 * 18 * 2, 16 + 34 * floor(num / 4), 34, 0x8F5F);
    tft.drawFastVLine(37 + num % 4 * 18 * 2, 16 + 34 * floor(num / 4), 34, 0x8F5F);
    tft.drawFastHLine(7 + num % 4 * 18 * 2, 16 + 34 * floor(num / 4), 6, 0x8F5F);
    tft.drawFastHLine(31 + num % 4 * 18 * 2, 16 + 34 * floor(num / 4), 6, 0x8F5F);
    tft.drawFastHLine(7 + num % 4 * 18 * 2, 16 + 34 + 34 * floor(num / 4), 6, 0x8F5F);
    tft.drawFastHLine(31 + num % 4 * 18 * 2, 16 + 33 + 34 * floor(num / 4), 6, 0x8F5F);
}

void showDesktop() {
    drawBackground(0);
    drawTaskbar(-1);
    drawClock(unixtimestamp + millis() / 1000);
}

void drawFolderView(int insideFolder, int currentlySelected) {
    tft.fillScreen(0xAD55);

    for (int i = 0; i < folders[insideFolder].contents.size(); i++) {
        ////Serial.println(folders[insideFolder].getFileName(i).substring(folders[insideFolder].getFileName(i).indexOf(".") + 1, folders[insideFolder].getFileName(i).indexOf("]")));
        if (folders[insideFolder].getFileName(i).substring(folders[insideFolder].getFileName(i).indexOf(".") + 1, folders[insideFolder].getFileName(i).indexOf("]")) == "TXT") {  //! EXISTENCE IS PAIN
            drawBMPCustom(16 + (i % 4 * 18 * 2), 20 + 34 * floor(i / 4), 6, 2, text_file, sizeof(text_file), 0);                                                                  //Draw file icon
            tft.setCursor(11 + (i % 4 * 18 * 2), 40 + 32 * floor(i / 4));
            tft.print(folders[insideFolder].getFileName(i).substring(folders[insideFolder].getFileName(i).indexOf("[") + 1, folders[insideFolder].getFileName(i).indexOf(".")));
        } else {
            drawBMPCustom(16 + (i % 4 * 18 * 2), 20 + 34 * floor(i / 4), 6, 2, unknown_file, sizeof(unknown_file), 0);
            tft.setCursor(11 + (i % 4 * 18 * 2), 40 + 32 * floor(i / 4));
            tft.print(folders[insideFolder].getFileName(i).substring(folders[insideFolder].getFileName(i).indexOf("[") + 1, folders[insideFolder].getFileName(i).indexOf(".")));
        }
        drawFileSelection(currentlySelected);
    }
    drawClock(unixtimestamp + millis() / 1000);
}

void drawClock(time_t currentTimestamp) {
    struct tm *tmp = gmtime(&currentTimestamp);
    tft.fillRect(56, 1, 5 * 6 + 20, 9, 0);
    tft.setTextColor(0xFFFF);
    tft.setCursor(64, 2);
    String currentHour = String((tmp->tm_hour + timezoneOffset) % 12) + ":" + String("0").substring(0, 1 - (tmp->tm_min > 9)) + String(tmp->tm_min);
    if (tmp->tm_hour + timezoneOffset > 12) {
        currentHour += "PM";
    } else {
        currentHour += "AM";
    }
    tft.println(currentHour);
}
time_t lastTime = 0;
void drawClockApp() {
    time_t currentTime = unixtimestamp + millis() / 1000;

    struct tm *tmp = gmtime(&currentTime);
    if (lastTime == currentTime) {
        return;
    }
    tft.fillRect(25, 10, 110, 96, 0);
    tft.drawCircle(60, 45, 30, 0xFFFF);  //TODO: Make this prettier

    double s = ((tmp->tm_sec - 0) * (TWO_PI - 0) / (60 - 0) + 0) - HALF_PI;                           //
    double m = ((tmp->tm_min - 0) * (TWO_PI - 0) / (60 - 0) + 0) - HALF_PI;                           // This section calculates the rotation of the hands of the clock
    double h = (((tmp->tm_hour + timezoneOffset) % 12 - 0) * (TWO_PI - 0) / (12 - 0) + 0) - HALF_PI;  //

    float secondHandLength = 27;
    float minuteHandLength = 20;
    float hourHandLength = 15;

    tft.drawLine(60, 45, 60 + cos(s) * secondHandLength, 45 + sin(s) * secondHandLength, 0xF800);
    tft.drawLine(60, 45, 60 + cos(m) * minuteHandLength, 45 + sin(m) * minuteHandLength, 0xFFFF);
    tft.drawLine(60, 45, 60 + cos(h) * hourHandLength, 45 + sin(h) * hourHandLength, 0xFFFF);

    std::vector<String> months{"Jan", "Feb", "Mar", "Apr", "May", "Jun", "Jul", "Aug", "Sep", "Oct", "Nov", "Dec"};
    tft.setCursor(25, 80);
    tft.println(String(tmp->tm_mday + 1) + " of " + months.at(tmp->tm_mon) + " " + String(tmp->tm_year + 1870));
    tft.setCursor(25, 88);
    tft.println(String(tmp->tm_hour + timezoneOffset) + ":" + String("0").substring(0, 1 - (tmp->tm_min > 9)) + String(tmp->tm_min) + ":" + String("0").substring(0, 1 - (tmp->tm_sec > 9)) + String(tmp->tm_sec));
    lastTime = currentTime;
}

void setup() {
    // put your setup code here, to run once:
    Serial.begin(230400);
#if defined(ST7735_RST_PIN)  // reset like Adafruit does
    FastPin<ST7735_RST_PIN>::setOutput();
    FastPin<ST7735_RST_PIN>::hi();
    FastPin<ST7735_RST_PIN>::lo();
    delay(1);
    FastPin<ST7735_RST_PIN>::hi();
#endif
    delay(500);
    //tft.initR(INITR_BLACKTAB);  // Init ST7735S chip, black tab.
    tft.begin();

    Serial.println(F("Initialized"));
    tft.fillScreen(0);
    tft.setRotation(1);

    tft.setTextColor(0xFFFF);
    tft.setTextWrap(true);
    tft.fillRect(0, 0, 160, 5, 0);
    folders[0].contents.push_back("[READ.TXT]Congratulations! \n\nYou managed to get the OS to work! \n\nTry creating a text file, or load one from an SD \ncard or something.");

    pinMode(RIGHT, INPUT_PULLUP);
    pinMode(LEFT, INPUT_PULLUP);
    pinMode(A, INPUT_PULLUP);
    pinMode(B, INPUT_PULLUP);
    pinMode(START, INPUT_PULLUP);

    char inputChar = 0;
    String time;

    tft.setCursor(2, 3);
    tft.println("Loading data from PC...");
    tft.setCursor(2, 11);
    tft.println("Press A to skip");
    while (digitalRead(A)) {
        if (millis() >= 5000) {
            tft.setCursor(2, 19);
            tft.println("FAILED!");
            delay(100);
            break;
        }
        if (Serial.available() > 0) {
            inputChar = Serial.read();

            if (inputChar != 's') {
                time += inputChar;
                inputChar = 0;
            } else {
                for (int i = 0; i < time.length(); i++) {
                    char c = time.charAt(i);
                    Serial.println(c);
                    if (c < '0' || c > '9') {
                        break;
                    }
                    unixtimestamp *= 10;
                    unixtimestamp += (c - '0');
                }

                struct tm *tmp = gmtime(&unixtimestamp);
                Serial.println(String(tmp->tm_hour + timezoneOffset) + ":" + String(tmp->tm_min));
                tft.println(time);
                tft.println(String(tmp->tm_hour + timezoneOffset) + ":" + String(tmp->tm_min));
                tft.println(String(tmp->tm_mday + 1) + "/" + String(tmp->tm_mon + 1) + "/" + String(tmp->tm_year + 1870));
                delay(1000);
                break;
            }
        }
    }  //Wait for A to be pressed
    drawBackground(0);
    drawTaskbar(-1);
    drawFileSelection(0);
}

int currentlySelected = 0;
int insideFolder = -1;
bool viewingFile = false;
bool taskbarFocus = false;
int currentlyOpenApp = -1;

uint32_t execTime = 0;
void loop() {
    // put your main code here, to run repeatedly:
    execTime = millis();
    currentRIGHTstate = digitalRead(RIGHT);
    currentLEFTstate = digitalRead(LEFT);
    currentAstate = digitalRead(A);
    currentBstate = digitalRead(B);
    currentSTARTstate = digitalRead(START);

    if (insideFolder >= 0) {  //If this is true then we must be inside a folder
        //TODO: Add support for nested folders.
        if (currentRIGHTstate != lastRIGHTstate && !currentRIGHTstate && currentlySelected + 1 < folders[insideFolder].contents.size() && !viewingFile) {  //Move selection to the right
            currentlySelected++;
            drawFolderView(insideFolder, currentlySelected);
        }
        if (currentLEFTstate != lastLEFTstate && !currentLEFTstate && currentlySelected > 0 && !viewingFile) {  //Move selection to the left
            currentlySelected--;
            drawFolderView(insideFolder, currentlySelected);
        }
        if (currentAstate != lastAstate && !currentAstate) {  //Open file
                                                              //TODO: add support for image files.
            viewingFile = true;
            tft.fillScreen(ST7735_WHITE);
            tft.setCursor(2, 10);
            tft.setTextColor(0);
            tft.print(folders[insideFolder].getFileContents(currentlySelected));
        }
        if (currentBstate != lastBstate && !currentBstate) {
            if (viewingFile) {
                tft.setTextColor(ST7735_WHITE);
                viewingFile = false;
                drawFolderView(insideFolder, currentlySelected);
            } else {
                currentlySelected = insideFolder;
                insideFolder = -1;
                showDesktop();
                drawFileSelection(currentlySelected);
            }
        }
    } else {                                                                                                                         //We must be on the desktop
        if (currentRIGHTstate != lastRIGHTstate && !currentRIGHTstate && currentlySelected + 1 < folders.size() && !taskbarFocus) {  //Move selection to the right
            currentlySelected++;
            showDesktop();
            drawFileSelection(currentlySelected);
        }
        if (currentLEFTstate != lastLEFTstate && !currentLEFTstate && currentlySelected > 0 && !taskbarFocus) {  //Move selection to the left
            currentlySelected--;
            showDesktop();
            drawFileSelection(currentlySelected);
        }
        if (currentSTARTstate != lastSTARTstate && !currentSTARTstate && !taskbarFocus) {  //Switch to taskbar
            drawBackground(0);
            drawTaskbar(-1);
            drawClock(unixtimestamp + millis() / 1000);
            taskbarFocus = true;
            currentlySelected = 0;
            drawTaskbar(currentlySelected);
            lastSTARTstate = currentSTARTstate;
        }
    }
    if (currentAstate != lastAstate && !currentAstate && insideFolder == -1 && !taskbarFocus) {  //Enter folder/open file
        insideFolder = currentlySelected;
        currentlySelected = 0;
        drawFolderView(insideFolder, currentlySelected);
    }
    if (taskbarFocus) {
        int numberOfApps = 1;  //TODO: Make this dynamic rather than a number I have to update
        if (currentRIGHTstate != lastRIGHTstate && !currentRIGHTstate && currentlySelected + 1 < numberOfApps) {
            currentlySelected++;
            drawTaskbar(currentlySelected);
        }
        if (currentLEFTstate != lastLEFTstate && !currentLEFTstate && currentlySelected > 0) {
            currentlySelected--;
            drawTaskbar(currentlySelected);
        }
        if (currentAstate != lastAstate && !currentAstate && currentlySelected == 0) {
            currentlyOpenApp = 0;
        }
        if (currentBstate != lastBstate && !currentBstate) {
            currentlyOpenApp = -1;
            showDesktop();
            drawTaskbar(currentlySelected);
        }
        if (currentSTARTstate != lastSTARTstate && !currentSTARTstate && currentlyOpenApp <= -1) {
            taskbarFocus = false;
            currentlySelected = 0;
            showDesktop();
            drawFileSelection(currentlySelected);
        }
    }

    switch (currentlyOpenApp) {
        case 0:
            drawClockApp();
            break;
        default:
            break;
    }

    lastRIGHTstate = currentRIGHTstate;
    lastLEFTstate = currentLEFTstate;
    lastAstate = currentAstate;
    lastBstate = currentBstate;
    lastSTARTstate = currentSTARTstate;

    time_t currentTimestamp = unixtimestamp + millis() / 1000;
    if (currentTimestamp % 60 == 0 || millis() < 10000) {
        drawClock(currentTimestamp);
    }

    ////double fps = pow(((millis() - execTime) * 0.001), -1);
    ////fpsCounter(fps);
    ////delay((millis() - execTime) * 2);  //* Wait for twice as long as it took to draw the frame.
}